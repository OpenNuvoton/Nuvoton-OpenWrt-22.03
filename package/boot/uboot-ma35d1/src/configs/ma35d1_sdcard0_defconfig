## package/boot/uboot-ma35d1/src/configs/ma35d1_sdcard0_defconfig
```kconfig
CONFIG_ARM=y
CONFIG_POSITION_INDEPENDENT=y
CONFIG_ARCH_NUVOTON=y
CONFIG_SYS_TEXT_BASE=0x85500000
CONFIG_SYS_MALLOC_F_LEN=0x4000
CONFIG_ENV_OFFSET=0x40000
CONFIG_DM_GPIO=y
CONFIG_NR_DRAM_BANKS=1
CONFIG_ARMV8_SET_SMPEN=y
CONFIG_DISTRO_DEFAULTS=y
# CONFIG_ARCH_FIXUP_FDT_MEMORY is not set
CONFIG_BOOTDELAY=3
# CONFIG_USE_BOOTCOMMAND is not set
# CONFIG_CONSOLE_MUX is not set
CONFIG_BOARD_LATE_INIT=y
CONFIG_SYS_PROMPT="MA35D1> "
CONFIG_CMD_BOOTEFI_HELLO=y
CONFIG_CMD_BOOTEFI_SELFTEST=y
CONFIG_CMD_MMC=y
CONFIG_CMD_MTD=y
# CONFIG_CMD_POWEROFF is not set
CONFIG_CMD_USB=y
# CONFIG_CMD_NFS is not set
# CONFIG_CMD_MII is not set
CONFIG_CMD_BMP=y
CONFIG_CMD_EFIDEBUG=y
CONFIG_CMD_EXT4_WRITE=y
CONFIG_CMD_UBI=y
CONFIG_PARTITION_TYPE_GUID=y
CONFIG_DEFAULT_DEVICE_TREE="ma35d1-sdcard0"
CONFIG_ENV_IS_IN_MMC=y
CONFIG_CLK=y
CONFIG_MA35D1_CLK_CCF=y
CONFIG_MA35D1_GPIO=y
CONFIG_DM_MMC=y
CONFIG_MMC_SDHCI=y
CONFIG_MMC_SDHCI_SDMA=y
CONFIG_MMC_SDHCI_DWCMSHC=y
CONFIG_MTD=y
CONFIG_DM_MTD=y
CONFIG_MTD_RAW_NAND=y
CONFIG_SYS_NAND_USE_FLASH_BBT=y
CONFIG_NAND_MA35D1=y
CONFIG_MTD_SPI_NAND=y
CONFIG_DM_SPI_FLASH=y
CONFIG_SPI_FLASH_BAR=y
CONFIG_SPI_FLASH_ATMEL=y
CONFIG_SPI_FLASH_EON=y
CONFIG_SPI_FLASH_GIGADEVICE=y
CONFIG_SPI_FLASH_ISSI=y
CONFIG_SPI_FLASH_MACRONIX=y
CONFIG_SPI_FLASH_SPANSION=y
CONFIG_SPI_FLASH_STMICRO=y
CONFIG_SPI_FLASH_SST=y
CONFIG_SPI_FLASH_WINBOND=y
CONFIG_SPI_FLASH_XMC=y
CONFIG_SPI_FLASH_MTD=y
CONFIG_PHY_REALTEK=y
CONFIG_ETH_DESIGNWARE=y
CONFIG_GMAC_MA35D1=y
CONFIG_PINCTRL=y
CONFIG_DM_RESET=y
CONFIG_SPECIFY_CONSOLE_INDEX=y
CONFIG_CONS_INDEX=0
CONFIG_DM_SERIAL=y
CONFIG_SPI=y
CONFIG_DM_SPI=y
CONFIG_MA35D1_SPI=y
CONFIG_USB=y
CONFIG_DM_USB=y
CONFIG_USB_EHCI_HCD=y
CONFIG_USB_OHCI_HCD=y
CONFIG_SYS_USB_OHCI_MAX_ROOT_PORTS=0x1
CONFIG_DM_VIDEO=y
CONFIG_MA35D1_LCD=y
CONFIG_WDT=y
CONFIG_WDT_MA35D1=y
```

## target/linux/ma35d0/image/Config.in
```kconfig
if	TARGET_ma35d0
config MA35D0_SECURE_BOOT
	bool "MA35D0 Secure Boot"
	default n
	help
	  MA35D0 Secure Boot is a first level bootloader for the MA35D0
	  devices.

if	MA35D0_SECURE_BOOT

config MA35D0_AES_KEY
	string "AES Key"
	default "0A0BC81E5AFBF836C5E0CFBEA12C1E269A2EBC3B0B6EC39EEE1C7142F760EBC4"
	help
	  AES Key

config MA35D0_ECDSA_KEY
	string "ECDSA Key"
	default "8F1571E9975006A545DF854264F7B18934B5CB2EE619E66DBC0FBEA52C71C919"
	help
          ECDSA Key
endif
endif
```
