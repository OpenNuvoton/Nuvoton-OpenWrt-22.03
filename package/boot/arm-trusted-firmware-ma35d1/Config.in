## package/boot/arm-trusted-firmware-ma35d1/Config.in
```kconfig
config TFA_LOAD_SCP_BL2
        bool "Add SCP_BL2 image into FIP Image"
        default n
        depends on PACKAGE_trusted-firmware-a-ma35d1 && TARGET_ma35d1
config TFA_SCP_BL2_FILE
        string "Set SCP_BL2 binary file in Nuvoton/rtp"
        default "template.bin"
        depends on PACKAGE_trusted-firmware-a-ma35d1 && TFA_LOAD_SCP_BL2
        help
          The file name of RTP-M4 raw binary.

choice
        prompt "CPU Speed"
        depends on PACKAGE_trusted-firmware-a-ma35d1
config TFA_CPU650
        bool "650 MHz"
        depends on !TARGET_ma35d1
config TFA_CPU800
        bool "800 MHz"
        depends on TARGET_ma35d1
config TFA_CPU1G
        bool "1 GHz"
        depends on TARGET_ma35d1
endchoice

config TFA_PMIC_AUTO
        bool "Set PMIC automatically"
        default y
        depends on PACKAGE_trusted-firmware-a-ma35d1
choice
        prompt "PMIC Select"
        depends on PACKAGE_trusted-firmware-a-ma35d1 && !TFA_PMIC_AUTO
config TFA_PMIC_0
        bool "No PMIC"
config TFA_PMIC_1
        bool "DIALOG PMIC"
config TFA_PMIC_2
        bool "IP6103 PMIC"
config TFA_PMIC_3
        bool "APW7704F PMIC"
endchoice

config TFA_CPU_CORE_POWER
        int "MA35D1 CPU Core Power"
        default 128
        depends on PACKAGE_trusted-firmware-a-ma35d1 && !TFA_PMIC_AUTO && !TFA_PMIC_0
        help
          The cpu core power voltage
          decimal integer value.
          125 = 1.25V, 120 = 1.20V,
          1xx = 1.xxV, etc.

config TFA_CUSTOM_DDR_FILE_AUTO
        bool "Set Custom DDR header file automatically"
        default y
        depends on PACKAGE_trusted-firmware-a-ma35d1
choice
        prompt "MA35 Chip version"
        depends on PACKAGE_trusted-firmware-a-ma35d1 && TFA_CUSTOM_DDR_FILE_AUTO
config TFA_MA35_3F789
        bool "Part number with 3F[789]"
        depends on TARGET_ma35d0_iot
config TFA_MA35_3FHIJ
        bool "Part number with 3F[HIJ]"
        depends on TARGET_ma35d0_iot
config TFA_MA35_4F789
        bool "Part number with 4F[789]"
        depends on TARGET_ma35h0_hmi
config TFA_MA35_4FHIJ
        bool "Part number with 4F[HIJ]"
        depends on TARGET_ma35h0_hmi
config TFA_MA35_5KHIJ
        bool "Part number with 5K[HIJ]"
        depends on TARGET_ma35d05k_iotv1
config TFA_MA35_6A789
        bool "Part number with 6A[789]"
        depends on TARGET_ma35d1_som || TARGET_ma35d1_hmi
config TFA_MA35_6AHIJ
        bool "Part number with 6A[HIJ]"
        depends on TARGET_ma35d1_som || TARGET_ma35d1_hmi
config TFA_MA35_6F789
        bool "Part number with 6F[789]"
        depends on TARGET_ma35d1_iot || TARGET_ma35d1_iotv1
config TFA_MA35_6FHIJ
        bool "Part number with 6F[HIJ]"
        depends on TARGET_ma35d1_iot || TARGET_ma35d1_iotv1
endchoice
config TFA_CUSTOM_DDR_FILE
        string "Set Custom DDR header file in Nuvoton/ddr"
        default "MA35D16F987C_LQFP-216_MCP_WinbondDDR3L_512M_1PCS.h"
        depends on PACKAGE_trusted-firmware-a-ma35d1 && !TFA_CUSTOM_DDR_FILE_AUTO
```

## target/linux/ma35d05k/image/Config.in
```kconfig
if	TARGET_ma35d05k
config MA35D05K_SECURE_BOOT
	bool "MA35D05K Secure Boot"
	default n
	help
	  MA35D05K Secure Boot is a first level bootloader for the MA35D05K
	  devices.

if	MA35D05K_SECURE_BOOT

config MA35D05K_AES_KEY
	string "AES Key"
	default "0A0BC81E5AFBF836C5E0CFBEA12C1E269A2EBC3B0B6EC39EEE1C7142F760EBC4"
	help
	  AES Key

config MA35D05K_ECDSA_KEY
	string "ECDSA Key"
	default "8F1571E9975006A545DF854264F7B18934B5CB2EE619E66DBC0FBEA52C71C919"
	help
          ECDSA Key
endif
endif
```

## target/linux/ma35h0/image/Config.in
```kconfig
if	TARGET_ma35h0
config MA35H0_SECURE_BOOT
	bool "MA35H0 Secure Boot"
	default n
	help
	  MA35H0 Secure Boot is a first level bootloader for the MA35H0
	  devices.

if	MA35H0_SECURE_BOOT

config MA35H0_AES_KEY
	string "AES Key"
	default "0A0BC81E5AFBF836C5E0CFBEA12C1E269A2EBC3B0B6EC39EEE1C7142F760EBC4"
	help
	  AES Key

config MA35H0_ECDSA_KEY
	string "ECDSA Key"
	default "8F1571E9975006A545DF854264F7B18934B5CB2EE619E66DBC0FBEA52C71C919"
	help
          ECDSA Key
endif

config TARGET_SDCARD_DATA_PARTSIZE
	int "SD card rootfs_data (overlay) partition size (in MiB)"
	default 100
	help
	  Size of the 4th SD-card partition ("rootfs_data") used as the
	  writable /overlay on top of a read-only squashfs root.

	  > 0 : build a read-only squashfs root plus this ext4 overlay, so
	        sysupgrade/OTA can preserve settings (mirrors squashfs+ubifs
	        NAND).
	  = 0 : build a single writable ext4 root and no overlay partition;
	        settings are preserved via the sysupgrade config backup.
endif
```
